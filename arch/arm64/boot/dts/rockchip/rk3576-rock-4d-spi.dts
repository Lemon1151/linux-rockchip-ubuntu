// SPDX-License-Identifier: (GPL-2.0+ OR MIT)
/*
 * Copyright (c) 2025 Rockchip Electronics Co., Ltd.
 * Copyright (c) 2025 Radxa Computer (Shenzhen) Co., Ltd.
 *
 */

/dts-v1/;

#include "rk3576-rock-4d.dts"

/ {
	model = "Radxa ROCK 4D SPI";
	compatible = "radxa,rock-4d-spi", "radxa,rock-4d", "rockchip,rk3576";
};
